## components/device_link/Kconfig
```kconfig
menu "Experimental S3/C5 diagnostic link"
config CYD_LINK_ENABLE
    bool "Enable diagnostic link (not network/app offload)"
    default n
    help
        S3 identifies as application host and C5 as connectivity companion.
        This increment only negotiates and tests a serial link. Existing services
        remain standalone. No Lua API, secret transfer or wireless proxy is enabled.
config CYD_LINK_WIRING_CONFIRMED
    bool "I verified the exposed UART wiring against both actual board schematics"
    depends on CYD_LINK_ENABLE
    default n
config CYD_LINK_TX_GPIO
    int "UART1 TX GPIO (-1 until actual connector is verified)"
    depends on CYD_LINK_ENABLE
    range -1 48
    default -1
config CYD_LINK_RX_GPIO
    int "UART1 RX GPIO (-1 until actual connector is verified)"
    depends on CYD_LINK_ENABLE
    range -1 48
    default -1
config CYD_LINK_BAUD
    int "UART baud"
    depends on CYD_LINK_ENABLE
    range 115200 921600
    default 115200
endmenu
```

## components/paired_system/Kconfig
```kconfig
menu "CYD paired tablet"
config CYD_PAIRED_SYSTEM
    bool "Build the unified S3/C5 tablet roles"
    default n
    depends on CYD_LINK_ENABLE && CYD_LINK_WIRING_CONFIRMED
    help
        S3 application host, C5 management/radio/storage gateway. Both boards
        require matching 0.5 service support. Standalone recovery remains separate.
endmenu
```

## main/Kconfig.projbuild
```kconfig
menu "CYD OS"
config CYD_BOARD_CONFIRMED
    bool "I verified the selected board model, revision and manufacturer wiring"
    default n
    help
        Hardware outputs remain disabled until you explicitly confirm the revision.
        Select the matching board profile via CYD_BOARD before building.
config CYD_WIFI_SSID
    string "Initial station SSID (imported once into saved networks)"
    default ""
config CYD_WIFI_PASSWORD
    string "Initial station password"
    default ""
config CYD_AP_PASSWORD
    string "Initial AP password (12-63 characters; blank generates one)"
    default ""
config CYD_API_TOKEN
    string "Deployment bearer token (minimum 24 characters)"
    default ""
endmenu
menu "NM-CYD-C5 touch calibration (landscape rotation 3)"
config CYD_C5_TOUCH_X_MIN
    int "Raw Y offset for screen X"
    range 0 4094
    default 225
config CYD_C5_TOUCH_X_SPAN
    int "Raw Y span for screen X"
    range 1 4095
    default 3413
config CYD_C5_TOUCH_Y_MIN
    int "Raw X offset for screen Y"
    range 0 4094
    default 403
config CYD_C5_TOUCH_Y_SPAN
    int "Raw X span for screen Y"
    range 1 4095
    default 3334
endmenu
```

## sdkconfig.defaults
```kconfig
CONFIG_ESPTOOLPY_FLASHMODE_QIO=y
CONFIG_ESPTOOLPY_FLASHSIZE_16MB=y
CONFIG_SPIRAM=y
CONFIG_SPIRAM_SPEED_80M=y
CONFIG_SPIRAM_USE_MALLOC=y
CONFIG_ESP_DEFAULT_CPU_FREQ_MHZ_240=y
CONFIG_FREERTOS_HZ=1000
CONFIG_PARTITION_TABLE_CUSTOM=y
CONFIG_PARTITION_TABLE_CUSTOM_FILENAME="partitions.csv"
CONFIG_FATFS_LFN_HEAP=y
CONFIG_FATFS_MAX_LFN=128
CONFIG_FATFS_FS_LOCK=8
CONFIG_FATFS_USE_FASTSEEK=y
CONFIG_COMPILER_OPTIMIZATION_SIZE=y
CONFIG_LV_COLOR_DEPTH_16=y
CONFIG_LV_USE_CLIB_MALLOC=y
CONFIG_LV_USE_SYSMON=n
CONFIG_ESP_MAIN_TASK_STACK_SIZE=8192
CONFIG_HTTPD_MAX_REQ_HDR_LEN=1024
CONFIG_HTTPD_MAX_URI_LEN=256

CONFIG_BOOTLOADER_APP_ROLLBACK_ENABLE=y
CONFIG_BOOTLOADER_LOG_LEVEL_WARN=y

CONFIG_LV_FONT_MONTSERRAT_20=y
CONFIG_LV_FONT_MONTSERRAT_28=y
```
